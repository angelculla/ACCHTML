const char graph_pb[] PROGMEM = {
0x89, 0x50, 0x4E, 0x47, 0x0D, 0x0A, 0x1A, 0x0A, 0x00, 0x00, 0x00, 0x0D, 0x49, 0x48, 0x44, 0x52, 0x00, 0x00, 0x00, 0x69, 0x00, 0x00, 0x00, 0xD5, 0x08, 0x02, 0x00, 0x00, 0x00, 0xDB, 0xE8, 0x49, 0x63, 0x00, 0x00, 0x00, 0x01, 0x73, 0x52, 0x47, 0x42, 0x00, 0xAE, 0xCE, 0x1C, 0xE9, 0x00, 0x00, 0x00, 0x04, 0x67, 0x41, 0x4D, 0x41, 0x00, 0x00, 0xB1, 0x8F, 0x0B, 0xFC, 0x61, 0x05, 0x00, 0x00, 0x00, 0x09, 0x70, 0x48, 0x59, 0x73, 0x00, 0x00, 0x0E, 0xC3, 0x00, 0x00, 0x0E, 0xC3, 0x01, 0xC7, 0x6F, 0xA8, 0x64, 0x00, 0x00, 0x05, 0x22, 0x49, 0x44, 0x41, 0x54, 0x78, 0x5E, 0xED, 0xD8, 0x4B, 0x10, 0x96, 0x63, 0x18, 0xC6, 0xF1, 0x6B, 0x2A, 0x2A, 0xB2, 0x42, 0x07, 0xAA, 0xB1, 0x52, 0x54, 0x94, 0x15, 0x2A, 0x2A, 0xAC, 0x14, 0x15, 0x65, 0x65, 0x2A, 0x3A, 0x60, 0x25, 0x2A, 0xAA, 0xB1, 0x31, 0x15, 0x15, 0x59, 0xA1, 0x03, 0xD5, 0x58, 0x29, 0x2A, 0xCA, 0x0A, 0x15, 0x15, 0x56, 0x8A, 0x8A, 0xB2, 0x32, 0x15, 0x1D, 0xB0, 0x12, 0x15, 0xD5, 0x64, 0xA1, 0xCD, 0x3B, 0x73, 0x2D, 0xAE, 0xEE, 0xD7, 0xCE, 0xFF, 0x9D, 0xFF, 0xCC, 0xB7, 0xBA, 0x37, 0xBF, 0xEF, 0x99, 0x79, 0xE6, 0xB9, 0x25, 0xBE, 0x36, 0x02, 0x17, 0xF8, 0x2E, 0x5D, 0xE0, 0x22, 0xF8, 0xA5, 0x0F, 0x32, 0x71, 0x01, 0xBB, 0xFA, 0x21, 0x68, 0xD8, 0x9D, 0xEF, 0x20, 0x4A, 0x04, 0xFE, 0xF5, 0x6E, 0xD8, 0x9D, 0xEB, 0x28, 0x4A, 0x04, 0x8C, 0xDD, 0xD9, 0x4E, 0xA2, 0x44, 0xC0, 0xD8, 0xFD, 0x75, 0xB9, 0x28, 0x11, 0x30, 0x76, 0x67, 0x3A, 0x8B, 0x12, 0x01, 0x63, 0x77, 0xBA, 0x8B, 0x28, 0x11, 0x30, 0x76, 0xA7, 0xBA, 0x8A, 0x12, 0x01, 0x63, 0xF7, 0xC7, 0x95, 0xA2, 0x44, 0xC0, 0xD8, 0x9D, 0xEC, 0x26, 0x4A, 0x04, 0x8C, 0xDD, 0xEF, 0x57, 0x89, 0x12, 0x01, 0x63, 0x57, 0x7F, 0x9E, 0xFC, 0x2F, 0x27, 0x79, 0xCF, 0xD6, 0xFF, 0x76, 0xEC, 0xB0, 0xAB, 0x0B, 0xD4, 0x27, 0x39, 0x77, 0xFF, 0x91, 0xDD, 0x2F, 0xD7, 0x8A, 0x12, 0x01, 0x73, 0xCF, 0x9E, 0xE8, 0x2E, 0x4A, 0x04, 0x8C, 0xDD, 0xF1, 0x1E, 0xA2, 0x44, 0xC0, 0xD8, 0x1D, 0xEB, 0x29, 0x4A, 0x04, 0x8C, 0xDD, 0xD1, 0x5E, 0xA2, 0x44, 0xC0, 0xD8, 0xFD, 0x74, 0xBD, 0x28, 0x11, 0x30, 0x76, 0x47, 0x7A, 0x8B, 0x12, 0x01, 0x63, 0x77, 0xB8, 0x8F, 0x28, 0x11, 0x30, 0x76, 0x87, 0xFA, 0x8A, 0x12, 0x01, 0x63, 0xF7, 0xE3, 0x0D, 0xA2, 0x44, 0x80, 0x1D, 0x54, 0xFD, 0x35, 0x86, 0x1D, 0x76, 0x6D, 0x05, 0xEA, 0xF3, 0xEC, 0x51, 0xB0, 0xAB, 0x0B, 0xD4, 0x27, 0x1B, 0xE7, 0xEE, 0x60, 0x3F, 0x51, 0x22, 0x60, 0xEE, 0x8A, 0x03, 0xFD, 0x45, 0x89, 0x80, 0xB1, 0xFB, 0xEE, 0x66, 0x51, 0x22, 0x60, 0xEC, 0xF6, 0x0F, 0x10, 0x25, 0x02, 0xC6, 0x6E, 0xDF, 0x40, 0x51, 0x22, 0x60, 0xEC, 0xF6, 0x0E, 0x12, 0x25, 0x02, 0xC6, 0xEE, 0x9B, 0x5B, 0x45, 0x89, 0x80, 0xB1, 0xDB, 0x33, 0x58, 0x94, 0x08, 0x18, 0xBB, 0xDD, 0x43, 0x44, 0x89, 0x80, 0xB1, 0xFB, 0xFA, 0x36, 0x51, 0x22, 0xC0, 0x1E, 0xA5, 0xFE, 0x1A, 0xC3, 0x0E, 0xBB, 0xB6, 0x02, 0xF5, 0x79, 0x76, 0x50, 0xD8, 0xD5, 0x05, 0xEA, 0x93, 0x8D, 0x73, 0xF7, 0xC5, 0x9D, 0xA2, 0x44, 0xC0, 0xDC, 0x15, 0xBB, 0x86, 0x8A, 0x12, 0x01, 0x63, 0xB7, 0x73, 0x98, 0x28, 0x11, 0x30, 0x76, 0x3B, 0x86, 0x8B, 0x12, 0x01, 0x63, 0xF7, 0xD9, 0xDD, 0xA2, 0x44, 0xC0, 0xD8, 0x6D, 0x1F, 0x21, 0x4A, 0x04, 0x8C, 0xDD, 0xB6, 0x91, 0xA2, 0x44, 0xC0, 0xD8, 0x6D, 0x1D, 0x25, 0x4A, 0x04, 0x8C, 0xDD, 0x27, 0xF7, 0x8A, 0x12, 0x01, 0x63, 0xF7, 0xF1, 0x7D, 0xA2, 0x44, 0x80, 0x3D, 0x4A, 0xFD, 0x35, 0x86, 0x1D, 0x76, 0x6D, 0x05, 0xEA, 0xF3, 0xEC, 0xA0, 0xB0, 0xAB, 0x0B, 0xD4, 0x27, 0x1B, 0xE7, 0x6E, 0xCB, 0x68, 0x51, 0x22, 0x60, 0xEE, 0x8A, 0xCD, 0x63, 0x44, 0x89, 0x80, 0xB1, 0xFB, 0xE0, 0x41, 0x51, 0x22, 0x60, 0xEC, 0x36, 0x8D, 0x15, 0x25, 0x02, 0xC6, 0x6E, 0xE3, 0x38, 0x51, 0x22, 0x60, 0xEC, 0x36, 0x8C, 0x17, 0x25, 0x02, 0xC6, 0xEE, 0xBD, 0x87, 0x45, 0x89, 0x80, 0xB1, 0x5B, 0x3F, 0x41, 0x94, 0x08, 0x18, 0xBB, 0x75, 0x13, 0x45, 0x89, 0x80, 0xB1, 0x7B, 0xF7, 0x11, 0x51, 0x22, 0xC0, 0x1E, 0xA5, 0xFE, 0x1A, 0xC3, 0x0E, 0xBB, 0xB6, 0x02, 0xF5, 0x79, 0x76, 0x50, 0xD8, 0xD5, 0x05, 0xEA, 0x93, 0x8D, 0x73, 0xB7, 0x76, 0x92, 0x28, 0x11, 0x30, 0x77, 0xC5, 0x9A, 0xC9, 0xA2, 0x44, 0xC0, 0xD8, 0xAD, 0x9E, 0x22, 0x4A, 0x04, 0x8C, 0xDD, 0x5B, 0x8F, 0x8B, 0x12, 0x01, 0x63, 0xB7, 0x6A, 0xAA, 0x28, 0x11, 0x30, 0x76, 0x2B, 0xA7, 0x89, 0x12, 0x01, 0x63, 0xB7, 0x62, 0xBA, 0x28, 0x11, 0x30, 0x76, 0xCB, 0x67, 0x88, 0x12, 0x01, 0x63, 0xF7, 0xC6, 0x93, 0xA2, 0x44, 0xC0, 0xD8, 0xBD, 0xFE, 0x94, 0x28, 0x11, 0x60, 0x8F, 0x52, 0x7F, 0x8D, 0x61, 0x87, 0x5D, 0x5B, 0x81, 0xFA, 0x3C, 0x3B, 0x28, 0xEC, 0xEA, 0x02, 0xF5, 0xC9, 0xC6, 0xB9, 0x5B, 0x36, 0x53, 0x94, 0x08, 0x98, 0xBB, 0xE2, 0x95, 0x67, 0x45, 0x89, 0x80, 0xB1, 0x5B, 0x3A, 0x4B, 0x94, 0x08, 0x18, 0xBB, 0x25, 0xB3, 0x45, 0x89, 0x80, 0xB1, 0x5B, 0x3C, 0x47, 0x94, 0x08, 0x18, 0xBB, 0x97, 0x9E, 0x17, 0x25, 0x02, 0xC6, 0x6E, 0xD1, 0x5C, 0x51, 0x22, 0x60, 0xEC, 0x16, 0xCE, 0x13, 0x25, 0x02, 0xC6, 0x6E, 0xC1, 0x7C, 0x51, 0x22, 0x60, 0xEC, 0x5E, 0x7C, 0x41, 0x94, 0x08, 0xB0, 0x47, 0xA9, 0xBF, 0xC6, 0xB0, 0xC3, 0xAE, 0xAD, 0x40, 0x7D, 0x9E, 0x1D, 0x14, 0x76, 0x75, 0x81, 0xFA, 0x64, 0xE3, 0xDC, 0xCD, 0x5F, 0x20, 0x4A, 0x04, 0xCC, 0x5D, 0x31, 0x6F, 0xA1, 0x28, 0x11, 0x30, 0x76, 0x73, 0x17, 0x89, 0x12, 0x01, 0x63, 0xF7, 0xDC, 0xCB, 0xA2, 0x44, 0xC0, 0xD8, 0xCD, 0x59, 0x2C, 0x4A, 0x04, 0x8C, 0xDD, 0xEC, 0x25, 0xA2, 0x44, 0xC0, 0xD8, 0xCD, 0x5A, 0x2A, 0x4A, 0x04, 0x8C, 0xDD, 0x33, 0xAF, 0x8A, 0x12, 0x01, 0x63, 0x37, 0x73, 0x99, 0x28, 0x11, 0x30, 0x76, 0x4F, 0xBF, 0x26, 0x4A, 0x04, 0xD8, 0xA3, 0xD4, 0x5F, 0x63, 0xD8, 0x61, 0xD7, 0x56, 0xA0, 0x3E, 0xCF, 0x0E, 0x0A, 0xBB, 0xBA, 0x40, 0x7D, 0xB2, 0x71, 0xEE, 0x9E, 0x78, 0x53, 0x94, 0x08, 0x98, 0xBB, 0x62, 0xC6, 0x72, 0x51, 0x22, 0x60, 0xEC, 0xA6, 0xAF, 0x10, 0x25, 0x02, 0xC6, 0x6E, 0xDA, 0x4A, 0x51, 0x22, 0x60, 0xEC, 0xA6, 0xAE, 0x12, 0x25, 0x02, 0xC6, 0xEE, 0xB1, 0xB7, 0x45, 0x89, 0x80, 0xB1, 0x9B, 0xB2, 0x5A, 0x94, 0x08, 0x18, 0xBB, 0xC9, 0x6B, 0x44, 0x89, 0x80, 0xB1, 0x9B, 0xB4, 0x56, 0x94, 0x08, 0x18, 0xBB, 0x47, 0xDF, 0x11, 0x25, 0x02, 0xEC, 0x51, 0xEA, 0xAF, 0x31, 0xEC, 0xB0, 0x6B, 0x2B, 0x50, 0x9F, 0x67, 0x07, 0x85, 0x5D, 0x5D, 0xA0, 0x3E, 0xD9, 0x38, 0x77, 0x13, 0xD7, 0x89, 0x12, 0x01, 0x73, 0x57, 0x4C, 0x58, 0x2F, 0x4A, 0x04, 0x8C, 0xDD, 0x43, 0xEF, 0x8B, 0x12, 0x01, 0x63, 0x37, 0x7E, 0x83, 0x28, 0x11, 0x30, 0x76, 0xE3, 0x36, 0x8A, 0x12, 0x01, 0x63, 0x37, 0x76, 0x93, 0x28, 0x11, 0x30, 0x76, 0x0F, 0x7C, 0x28, 0x4A, 0x04, 0x8C, 0xDD, 0x98, 0xCD, 0xA2, 0x44, 0xC0, 0xD8, 0x8D, 0xDE, 0x22, 0x4A, 0x04, 0x8C, 0xDD, 0xFD, 0x1F, 0x89, 0x12, 0x01, 0xF6, 0x28, 0xF5, 0xD7, 0x18, 0x76, 0xD8, 0xB5, 0x15, 0xA8, 0xCF, 0xB3, 0x83, 0xC2, 0xAE, 0x2E, 0x50, 0x9F, 0x6C, 0x9C, 0xBB, 0x7B, 0x3E, 0x15, 0x25, 0x02, 0xE6, 0xAE, 0x18, 0xB5, 0x55, 0x94, 0x08, 0x18, 0xBB, 0x91, 0xDB, 0x44, 0x89, 0x80, 0xB1, 0x1B, 0xB1, 0x5D, 0x94, 0x08, 0x18, 0xBB, 0xBB, 0x3E, 0x17, 0x25, 0x02, 0xC6, 0x6E, 0xF8, 0x0E, 0x51, 0x22, 0x60, 0xEC, 0x86, 0xED, 0x14, 0x25, 0x02, 0xC6, 0x6E, 0xE8, 0x2E, 0x51, 0x22, 0x60, 0xEC, 0xEE, 0xF8, 0x52, 0x94, 0x08, 0x18, 0xBB, 0xDB, 0xBF, 0x12, 0x25, 0x02, 0xEC, 0x51, 0xEA, 0xAF, 0x31, 0xEC, 0xB0, 0x6B, 0x2B, 0x50, 0x9F, 0x67, 0x07, 0x85, 0x5D, 0x5D, 0xA0, 0x3E, 0xD9, 0x38, 0x77, 0x43, 0x76, 0x8B, 0x12, 0x01, 0x73, 0x57, 0x0C, 0xDE, 0x23, 0x4A, 0x04, 0x8C, 0xDD, 0x2D, 0xDF, 0x8A, 0x12, 0x01, 0x63, 0x37, 0x68, 0xAF, 0x28, 0x11, 0x30, 0x76, 0x03, 0xF7, 0x89, 0x12, 0x01, 0x63, 0x37, 0x60, 0xBF, 0x28, 0x11, 0x30, 0x76, 0x37, 0x7D, 0x2F, 0x4A, 0x04, 0x8C, 0x5D, 0xFF, 0x03, 0xA2, 0x44, 0xC0, 0xD8, 0xF5, 0x3B, 0x28, 0x4A, 0x04, 0x8C, 0xDD, 0x8D, 0x3F, 0x88, 0x12, 0x01, 0xF6, 0x28, 0xF5, 0xD7, 0x18, 0x76, 0xD8, 0xB5, 0x15, 0xA8, 0xCF, 0xB3, 0x83, 0xC2, 0xAE, 0x2E, 0x50, 0x9F, 0x6C, 0x9C, 0xBB, 0xBE, 0x87, 0x44, 0x89, 0x80, 0xB9, 0x2B, 0xFA, 0x1C, 0x16, 0x25, 0x02, 0xC6, 0xAE, 0xF7, 0x11, 0x51, 0x22, 0x60, 0xEC, 0xAE, 0xFB, 0x59, 0x94, 0x08, 0x18, 0xBB, 0x5E, 0x47, 0x45, 0x89, 0x80, 0xB1, 0xEB, 0x79, 0x4C, 0x94, 0x08, 0x18, 0xBB, 0x1E, 0xC7, 0x45, 0x89, 0x80, 0xB1, 0xEB, 0x7E, 0x42, 0x94, 0x08, 0x18, 0xBB, 0x6B, 0x7E, 0x15, 0x25, 0x02, 0xC6, 0xEE, 0xEA, 0xDF, 0x44, 0x89, 0x00, 0x7B, 0x94, 0xFA, 0x6B, 0x0C, 0x3B, 0xEC, 0xDA, 0x0A, 0xD4, 0xE7, 0xD9, 0x41, 0x61, 0x57, 0x17, 0xA8, 0x4F, 0x36, 0xCE, 0x5D, 0xB7, 0x93, 0xA2, 0x44, 0xC0, 0xDC, 0x15, 0x57, 0xFC, 0x29, 0x4A, 0x04, 0x8C, 0x5D, 0xD7, 0x53, 0xA2, 0x44, 0xC0, 0xD8, 0x75, 0x39, 0x2D, 0x4A, 0x04, 0x8C, 0x5D, 0xE7, 0x33, 0xA2, 0x44, 0xC0, 0xD8, 0x5D, 0xF6, 0xB7, 0x28, 0x11, 0x30, 0x76, 0x9D, 0xCE, 0x8A, 0x12, 0x01, 0x63, 0xD7, 0xF1, 0x9C, 0x28, 0x11, 0x30, 0x76, 0x1D, 0xCE, 0x8B, 0x12, 0x01, 0x63, 0xA7, 0x0B, 0xA2, 0x44, 0x80, 0x3D, 0x4A, 0xFD, 0x35, 0x86, 0x1D, 0x76, 0x6D, 0x05, 0xEA, 0xF3, 0x17, 0x77, 0x01, 0xFC, 0xD4, 0x04, 0xFE, 0x01, 0xAF, 0xB7, 0xDD, 0x19, 0x33, 0xB2, 0xCA, 0xBE, 0x00, 0x00, 0x00, 0x00, 0x49, 0x45, 0x4E, 0x44, 0xAE, 0x42, 0x60, 0x82};

const char graph_google[] PROGMEM = {
0x89,0x50,0x4E,0x47,0x0D,0x0A,0x1A,0x0A,0x00,0x00,0x00,0x0D,0x49,0x48,0x44,0x52,
0x00,0x00,0x01,0x1B,0x00,0x00,0x00,0x68,0x08,0x06,0x00,0x00,0x00,0xC1,0xEC,0x54,
0xFA,0x00,0x00,0x00,0x09,0x70,0x48,0x59,0x73,0x00,0x00,0x01,0x8A,0x00,0x00,0x01,
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0xE9,0x93,0x45,0x91,0x00,0x00,0x00,0x00,0x49,0x45,0x4E,0x44,0xAE,0x42,0x60,0x82,
};
